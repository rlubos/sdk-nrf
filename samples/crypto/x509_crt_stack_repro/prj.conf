## CMakeLists.txt
```
#
# Copyright (c) 2026 Nordic Semiconductor ASA
#
# SPDX-License-Identifier: LicenseRef-Nordic-5-Clause
#

cmake_minimum_required(VERSION 3.20.0)

find_package(Zephyr REQUIRED HINTS $ENV{ZEPHYR_BASE})

project(x509_crt_stack_repro)

target_sources(app PRIVATE src/main.c)
```

## sample.yaml
```
sample:
  name: Mbed TLS X.509 stack reproducer
  description: |
    Minimal reproducer for a crash when parsing an X.509 certificate into a
    stack-allocated mbedtls_x509_crt context with NCS nRF Security enabled.

common:
  build_only: true
  tags:
    - ci_build
  platform_allow:
    - nrf52840dk/nrf52840
    - nrf5340dk/nrf5340/cpuapp
    - nrf54lm20dk/nrf54lm20a/cpuapp
  integration_platforms:
    - nrf52840dk/nrf52840
```

## prj.conf
```kconfig
#
# Copyright (c) 2026 Nordic Semiconductor ASA
#
# SPDX-License-Identifier: LicenseRef-Nordic-5-Clause
#

CONFIG_SERIAL=y
CONFIG_CONSOLE=y
CONFIG_UART_CONSOLE=y
CONFIG_PRINTK=y

CONFIG_LOG=y
CONFIG_LOG_PRINTK=y

CONFIG_MAIN_STACK_SIZE=8192

# Mbed TLS X.509 certificate parsing (matches tls_credentials parse_crt test).
CONFIG_MBEDTLS=y
CONFIG_MBEDTLS_X509_CRT_PARSE_C=y
CONFIG_MBEDTLS_PEM_PARSE_C=y
CONFIG_MBEDTLS_ENABLE_HEAP=y
CONFIG_MBEDTLS_HEAP_SIZE=8196

CONFIG_PSA_CRYPTO=y
CONFIG_PSA_WANT_KEY_TYPE_RSA_KEY_PAIR_IMPORT=y
CONFIG_PSA_WANT_KEY_TYPE_RSA_PUBLIC_KEY=y
CONFIG_PSA_WANT_ALG_SHA_256=y
CONFIG_PSA_WANT_ALG_RSA_PKCS1V15_SIGN=y
```

## src/main.c
```c
/*
 * Copyright (c) 2026 Nordic Semiconductor ASA
 *
 * SPDX-License-Identifier: LicenseRef-Nordic-5-Clause
 */

#include <zephyr/kernel.h>
#include <zephyr/sys/printk.h>
#include <zephyr/logging/log.h>

#include <mbedtls/x509_crt.h>

LOG_MODULE_REGISTER(cert, LOG_LEVEL_DBG);

/* DigiCert Global Root G2 (expires 2038-01-15 12:00:00) */
static const char test_server_cert[] =
	"-----BEGIN CERTIFICATE-----\n"
	"MIIDjjCCAnagAwIBAgIQAzrx5qcRqaC7KGSxHQn65TANBgkqhkiG9w0BAQsFADBh\n"
	"MQswCQYDVQQGEwJVUzEVMBMGA1UEChMMRGlnaUNlcnQgSW5jMRkwFwYDVQQLExB3\n"
	"d3cuZGlnaWNlcnQuY29tMSAwHgYDVQQDExdEaWdpQ2VydCBHbG9iYWwgUm9vdCBH\n"
	"MjAeFw0xMzA4MDExMjAwMDBaFw0zODAxMTUxMjAwMDBaMGExCzAJBgNVBAYTAlVT\n"
	"MRUwEwYDVQQKEwxEaWdpQ2VydCBJbmMxGTAXBgNVBAsTEHd3dy5kaWdpY2VydC5j\n"
	"b20xIDAeBgNVBAMTF0RpZ2lDZXJ0IEdsb2JhbCBSb290IEcyMIIBIjANBgkqhkiG\n"
	"9w0BAQEFAAOCAQ8AMIIBCgKCAQEAuzfNNNx7a8myaJCtSnX/RrohCgiN9RlUyfuI\n"
	"2/Ou8jqJkTx65qsGGmvPrC3oXgkkRLpimn7Wo6h+4FR1IAWsULecYxpsMNzaHxmx\n"
	"1x7e/dfgy5SDN67sH0NO3Xss0r0upS/kqbitOtSZpLYl6ZtrAGCSYP9PIUkY92eQ\n"
	"q2EGnI/yuum06ZIya7XzV+hdG82MHauVBJVJ8zUtluNJbd134/tJS7SsVQepj5Wz\n"
	"tCO7TG1F8PapspUwtP1MVYwnSlcUfIKdzXOS0xZKBgyMUNGPHgm+F6HmIcr9g+UQ\n"
	"vIOlCsRnKPZzFBQ9RnbDhxSJITRNrw9FDKZJobq7nMWxM4MphQIDAQABo0IwQDAP\n"
	"BgNVHRMBAf8EBTADAQH/MA4GA1UdDwEB/wQEAwIBhjAdBgNVHQ4EFgQUTiJUIBiV\n"
	"5uNu5g/6+rkS7QYXjzkwDQYJKoZIhvcNAQELBQADggEBAGBnKJRvDkhj6zHd6mcY\n"
	"1Yl9PMWLSn/pvtsrF9+wX3N3KjITOYFnQoQj8kVnNeyIv/iPsGEMNKSuIEyExtv4\n"
	"NeF22d+mQrvHRAiGfzZ0JFrabA0UWTW98kndth/Jsw1HKj2ZL7tcu7XUIOGZX1NG\n"
	"Fdtom/DzMNU+MeKNhJ7jitralj41E6Vf8PlwUHBHQRFXGU7Aj64GxJUTFy8bJZ91\n"
	"8rGOmaFvE7FBcf6IKshPECBV1/MUReXgRPTqh5Uykw7+U0b6LJ3/iyK5S9kJRaTe\n"
	"pLiaWN0bfVKfjllDiIGknibVb63dDcY3fe0Dkhvld1927jyNxF1WW6LZZm6zNTfl\n"
	"MrY=\n"
	"-----END CERTIFICATE-----\n";

struct {
	struct mbedtls_x509_crt crt;
	uint32_t after[80];
} test_env;

static void reproducer(void)
{
	int err;

	memset(test_env.after, 0xab, sizeof(test_env.after));

	LOG_HEXDUMP_DBG(test_env.after, sizeof(test_env.after), "Pre call");

	mbedtls_x509_crt_init(&test_env.crt);

	err = mbedtls_x509_crt_parse(&test_env.crt, test_server_cert, sizeof(test_server_cert));
	if (err != 0) {
		printk("Parsing error 0x%x\n", -err);
		goto out;
	}

	LOG_HEXDUMP_DBG(test_env.after, sizeof(test_env.after), "Post call");

	printk("Cert expires at %d/%d/%d\n", test_env.crt.valid_to.day, test_env.crt.valid_to.mon,
	       test_env.crt.valid_to.year);

out:
	mbedtls_x509_crt_free(&test_env.crt);
}

int main(void)
{
	printk("Parsing certificate with stack-allocated mbedtls_x509_crt\n");

	reproducer();

	printk("Done\n");

	return 0;
}
```
