## prj.conf
```kconfig
#
# Copyright (c) 2019 Nordic Semiconductor ASA
#
# SPDX-License-Identifier: LicenseRef-BSD-5-Clause-Nordic
#
# General config
CONFIG_TEST_RANDOM_GENERATOR=y
CONFIG_LOG=y
CONFIG_LOG_DEFAULT_LEVEL=3
CONFIG_STACK_SENTINEL=y

# Network
CONFIG_NETWORKING=y
CONFIG_NET_SOCKETS=y
CONFIG_NET_NATIVE=n

# BSD library
CONFIG_BSD_LIBRARY=y

# Use GPIO
CONFIG_GPIO=y
CONFIG_GPIO_NRFX=y
CONFIG_GPIO_NRF_P0=y

# UART interface
CONFIG_SERIAL=y
CONFIG_UART_INTERRUPT_DRIVEN=y
CONFIG_UART_2_NRF_UARTE=y
CONFIG_UART_2_NRF_FLOW_CONTROL=y

# LTE link control
CONFIG_LTE_LINK_CONTROL=y
CONFIG_LTE_AUTO_INIT_AND_CONNECT=n

# Stacks and heaps
CONFIG_MAIN_THREAD_PRIORITY=7
CONFIG_MAIN_STACK_SIZE=4096
CONFIG_HEAP_MEM_POOL_SIZE=16384
CONFIG_SYSTEM_WORKQUEUE_STACK_SIZE=8192

# AT_CMD
#CONFIG_AT_CMD_LOG_LEVEL_DBG=y

# Application-specific
CONFIG_SLM_AT_MODE=y
CONFIG_SLM_TCPIP_AT_MODE=y
CONFIG_SLM_GPS_AT_MODE=y
CONFIG_SLM_LOG_LEVEL_INF=y
```

## src/main.c
```c
/*
 * Copyright (c) 2019 Nordic Semiconductor ASA
 *
 * SPDX-License-Identifier: LicenseRef-BSD-5-Clause-Nordic
 */
#include <logging/log.h>

#include <zephyr.h>
#include <stdio.h>
#include <drivers/uart.h>
#include <string.h>
#include <bsd.h>
#include <lte_lc.h>
#include <hal/nrf_gpio.h>
#include <hal/nrf_power.h>
#include <hal/nrf_regulators.h>
#include "slm_at_host.h"

#if defined(CONFIG_SLM_CONNECT_UART_0) && defined(CONFIG_SLM_GPIO_WAKEUP)
#error CONFIG_SLM_GPIO_WAKEUP should not be defined when UART0 is used
#endif

LOG_MODULE_REGISTER(app, CONFIG_SLM_LOG_LEVEL);

/* global variable used across different files */
struct at_param_list m_param_list;

/**@brief Recoverable BSD library error. */
void bsd_recoverable_error_handler(uint32_t err)
{
	LOG_ERR("bsdlib recoverable error: %u", err);
}

void start_execute(void)
{
	int err;

	LOG_INF("Serial LTE Modem");
	err = slm_at_host_init();
	if (err != 0) {
		LOG_ERR("Failed to init at_host: %d", err);
		return;
	}

	/* Initialize AT Parser */
	err = at_params_list_init(&m_param_list, CONFIG_SLM_AT_MAX_PARAM);
	if (err) {
		LOG_ERR("Failed to init AT Parser: %d", err);
		return;
	}
}

void enter_sleep(u16_t mode)
{
	if (mode == SHUTDOWN_MODEM_ONLY) {
		lte_lc_power_off();
		return;
	}

#if defined(CONFIG_SLM_GPIO_WAKEUP)
	/*
	 * Due to errata 4, Always configure PIN_CNF[n].INPUT before
	 *  PIN_CNF[n].SENSE.
	 */
	nrf_gpio_cfg_input(CONFIG_SLM_MODEM_WAKEUP_PIN,
		NRF_GPIO_PIN_PULLUP);
	nrf_gpio_cfg_sense_set(CONFIG_SLM_MODEM_WAKEUP_PIN,
		NRF_GPIO_PIN_SENSE_LOW);
#endif

	/*
	 * The LTE modem also needs to be stopped by issuing a command
	 * through the modem API, before entering System OFF mode.
	 * Once the command is issued, one should wait for the modem
	 * to respond that it actually has stopped as there may be a
	 * delay until modem is disconnected from the network.
	 * Refer to https://infocenter.nordicsemi.com/topic/ps_nrf9160/
	 * pmu.html?cp=2_0_0_4_0_0_1#system_off_mode
	 */
	if (mode == SHUTDOWN_APP_MODEM) {
		lte_lc_power_off();
	}
	bsd_shutdown();
	nrf_regulators_system_off(NRF_REGULATORS_NS);
}

#if defined(CONFIG_SLM_GPIO_WAKEUP)
void main(void)
{
	u32_t rr = nrf_power_resetreas_get(NRF_POWER_NS);

	LOG_DBG("RR: 0x%08x", rr);
	if (rr & NRF_POWER_RESETREAS_OFF_MASK) {
		nrf_power_resetreas_clear(NRF_POWER_NS, 0x70017);
		start_execute();
	} else {
		LOG_INF("Sleep");
		enter_sleep(SHUTDOWN_APP_MODEM);
	}
}
#else
void main(void)
{
	start_execute();
}
#endif	/* CONFIG_THIN_GPIO_WAKEUP */
```

## src/slm_at_gps.c
```c
/*
 * Copyright (c) 2019 Nordic Semiconductor ASA
 *
 * SPDX-License-Identifier: LicenseRef-BSD-5-Clause-Nordic
 */
#include <logging/log.h>

#include <zephyr.h>
#include <stdio.h>
#include <nrf_socket.h>
#include "slm_at_gps.h"

LOG_MODULE_REGISTER(gps, CONFIG_SLM_LOG_LEVEL);

#define IS_FIX(_flag)       (_flag & NRF_GNSS_PVT_FLAG_FIX_VALID_BIT)
#define IS_UNHEALTHY(_flag) (_flag & NRF_GNSS_SV_FLAG_UNHEALTHY)

#define INVALID_SOCKET	-1

/**@brief List of supported AT commands. */
enum slm_gps_mode {
	GPS_MODE_STANDALONE,
	GPS_MODE_PSM,
	GPS_MODE_EDRX,
	GPS_MODE_AGPS
};

/**@brief List of supported AT commands. */
enum slm_gps_at_cmd_type {
	AT_GPSRUN,
	AT_GPS_MAX
};

/** forward declaration of cmd handlers **/
static int handle_at_gpsrun(const char *at_cmd);

#define MAX_GPS_CMD_LEN 32

/**@brief SLM AT Command list type. */
static slm_at_cmd_list_t m_at_list[AT_GPS_MAX] = {
	{AT_GPSRUN, "AT#XGPSRUN", "at#xgpsrun", handle_at_gpsrun},
};

static struct gps_client {
	int sock; /* Socket descriptor. */
	u16_t mask; /* NMEA mask */
	bool running; /* GPS running status */
	bool has_fix; /* At least one fix is got */
	at_cmd_handler_t callback;
} client;

static nrf_gnss_data_frame_t gps_data;
static char buf[64];

#define THREAD_STACK_SIZE	KB(1)
#define THREAD_PRIORITY		K_LOWEST_APPLICATION_THREAD_PRIO

static struct k_thread gps_thread;
static k_tid_t gps_thread_id;
static K_THREAD_STACK_DEFINE(gps_thread_stack, THREAD_STACK_SIZE);

/* global variable defined in different files */
extern struct at_param_list m_param_list;

static void gps_satellite_stats(void)
{
	static u8_t last_tracked;
	u8_t tracked = 0;
	u8_t in_fix = 0;
	u8_t unhealthy = 0;

	if (gps_data.data_id != NRF_GNSS_PVT_DATA_ID || client.has_fix) {
		return;
	}

	for (int i = 0; i < NRF_GNSS_MAX_SATELLITES; ++i) {
		if ((gps_data.pvt.sv[i].sv > 0) &&
		    (gps_data.pvt.sv[i].sv < 33)) {
			LOG_DBG("GPS tracking: %d", gps_data.pvt.sv[i].sv);
			tracked++;
			if (IS_FIX(gps_data.pvt.sv[i].flags)) {
				in_fix++;
			}
			if (IS_UNHEALTHY(gps_data.pvt.sv[i].flags)) {
				unhealthy++;
			}
		}
	}

	if (last_tracked != tracked) {
		sprintf(buf, "#XGPSS: tracking %d using %d unhealthy %d\r\n",
			tracked, in_fix, unhealthy);
		client.callback(buf);
		last_tracked = tracked;
	}
}

static void gps_pvt_notify(void)
{
	sprintf(buf, "#XGPSP: long %f lat %f\r\n",
		gps_data.pvt.longitude,
		gps_data.pvt.latitude);
	client.callback(buf);
	sprintf(buf, "#XGPSP: %04u-%02u-%02u %02u:%02u:%02u\r\n",
		gps_data.pvt.datetime.year,
		gps_data.pvt.datetime.month,
		gps_data.pvt.datetime.day,
		gps_data.pvt.datetime.hour,
		gps_data.pvt.datetime.minute,
		gps_data.pvt.datetime.seconds);
	client.callback(buf);
}

static void gps_thread_fn(void *arg1, void *arg2, void *arg3)
{
	ARG_UNUSED(arg1);
	ARG_UNUSED(arg2);
	ARG_UNUSED(arg3);

	while (true) {
		if (nrf_recv(client.sock, &gps_data, sizeof(gps_data), 0)
			<= 0) {
			LOG_ERR("GPS nrf_recv(): %d", -errno);
			sprintf(buf, "#XGPSRUN: %d\r\n", -errno);
			client.callback(buf);
			nrf_close(client.sock);
			client.running = false;
			break;
		}
		gps_satellite_stats();
		switch (gps_data.data_id) {
		case NRF_GNSS_PVT_DATA_ID:
			if (IS_FIX(gps_data.pvt.flags)) {
				gps_pvt_notify();
				if (!client.has_fix) {
					client.has_fix = true;
				}
			}
			break;
		case NRF_GNSS_NMEA_DATA_ID:
			if (client.has_fix) {
				client.callback("#XGPSN: ");
				client.callback(gps_data.nmea);
			}
			break;
		default:
			break;
		}
	}
}

static int do_gps_start(void)
{
	int ret = -EINVAL;

	nrf_gnss_fix_retry_t    fix_retry    = 0; /* unlimited retry period */
	nrf_gnss_fix_interval_t fix_interval = 1; /* 1s delay between fixes */
	nrf_gnss_delete_mask_t  delete_mask  = 0;
	nrf_gnss_nmea_mask_t    nmea_mask = (nrf_gnss_nmea_mask_t)client.mask;

	client.sock = nrf_socket(NRF_AF_LOCAL, NRF_SOCK_DGRAM, NRF_PROTO_GNSS);
	if (client.sock < 0) {
		LOG_ERR("Could not init socket (err: %d)", -errno);
		goto error;
	}
	ret = nrf_setsockopt(client.sock, NRF_SOL_GNSS, NRF_SO_GNSS_FIX_RETRY,
			&fix_retry, sizeof(fix_retry));
	if (ret != 0) {
		LOG_ERR("Failed to set fix retry value (err: %d)", -errno);
		goto error;
	}
	ret = nrf_setsockopt(client.sock, NRF_SOL_GNSS,
		NRF_SO_GNSS_FIX_INTERVAL, &fix_interval, sizeof(fix_interval));
	if (ret != 0) {
		LOG_ERR("Failed to set fix interval value (err: %d)", -errno);
		goto error;
	}
	ret = nrf_setsockopt(client.sock, NRF_SOL_GNSS, NRF_SO_GNSS_NMEA_MASK,
			&nmea_mask, sizeof(nmea_mask));
	if (ret != 0) {
		LOG_ERR("Failed to set nmea mask (err: %d)", -errno);
		goto error;
	}
	ret = nrf_setsockopt(client.sock, NRF_SOL_GNSS, NRF_SO_GNSS_START,
			&delete_mask, sizeof(delete_mask));
	if (ret != 0) {
		LOG_ERR("Failed to start GPS (err: %d)", -errno);
		goto error;
	}

	/* Start GPS listening thread */
	if (gps_thread_id != NULL) {
		k_thread_resume(gps_thread_id);
	} else {
		gps_thread_id = k_thread_create(&gps_thread, gps_thread_stack,
				K_THREAD_STACK_SIZEOF(gps_thread_stack),
				gps_thread_fn, NULL, NULL, NULL,
				THREAD_PRIORITY, 0, K_NO_WAIT);
	}

	client.running = true;
	LOG_DBG("GPS started");

	sprintf(buf, "#XGPSRUN: 1,%d\r\n", client.mask);
	client.callback(buf);
	return 0;

error:
	LOG_ERR("GPS start failed: %d", ret);
	sprintf(buf, "#XGPSRUN: %d\r\n", ret);
	client.callback(buf);
	client.running = false;

	return -errno;
}

static int do_gps_stop(void)
{
	int ret = 0;
	nrf_gnss_delete_mask_t	delete_mask  = 0;

	if (client.sock != INVALID_SOCKET) {
		ret = nrf_setsockopt(client.sock, NRF_SOL_GNSS,
			NRF_SO_GNSS_STOP, &delete_mask, sizeof(delete_mask));
		if (ret != 0) {
			LOG_ERR("Failed to stop GPS (err: %d)", -errno);
			ret = -errno;
		} else {
			k_thread_suspend(gps_thread_id);
			nrf_close(client.sock);
			client.running = false;
			client.callback("#XGPSRUN: 0\r\n");
			LOG_DBG("GPS stopped");
		}

	}

	return ret;
}

/**@brief handle AT#XGPSRUN commands
 *  AT#XGPSRUN=<op>[,<mask>]
 *  AT#XGPSRUN?
 *  AT#XGPSRUN=? TEST command not supported
 */
static int handle_at_gpsrun(const char *at_cmd)
{
	int err = -EINVAL;
	u16_t op;

	switch (at_parser_cmd_type_get(at_cmd)) {
	case AT_CMD_TYPE_SET_COMMAND:
		if (at_params_valid_count_get(&m_param_list) < 2) {
			return -EINVAL;
		}

		err = at_params_short_get(&m_param_list, 1, &op);
		if (err < 0) {
			return err;
		};

		if (op == 1) {
			if (at_params_valid_count_get(&m_param_list) > 2) {
				err = at_params_short_get(&m_param_list, 2,
							  &client.mask);
				if (err < 0) {
					return err;
				};
			}

			if (client.running) {
				LOG_WRN("GPS is running");
			} else {
				err = do_gps_start();
			}
		} else if (op == 0) {
			if (!client.running) {
				LOG_WRN("GPS is not running");
			} else {
				err = do_gps_stop();
			}
		}

		break;

	case AT_CMD_TYPE_READ_COMMAND:
		if (client.running) {
			sprintf(buf, "#XGPSRUN: 1,%d\r\n", client.mask);
		} else {
			sprintf(buf, "#XGPSRUN: 0\r\n");
		}

		client.callback(buf);

		err = 0;
		break;

	case AT_CMD_TYPE_TEST_COMMAND:
	default:
		err = -EINVAL;
		break;
	}

	return err;
}

/**@brief API to handle GPS AT commands
 */
int slm_at_gps_parse(const u8_t *param, u8_t length)
{
	int ret = -ENOTSUP;
	u8_t cmd[MAX_GPS_CMD_LEN];
	size_t cmd_len = sizeof(cmd);

	ARG_UNUSED(length);

	ret = at_parser_params_from_str(param, NULL, &m_param_list);
	if (ret < 0) {
		LOG_ERR("Failed to parse command");
		return ret;
	};

	ret = at_params_string_get(&m_param_list, 0, cmd, &cmd_len);
	if (ret < 0) {
		LOG_ERR("Failed to retrieve command");
		return ret;
	};

	if (cmd_len < 3) {
		return -ENOTSUP;
	}

	for (int i = 0; i < AT_GPS_MAX; i++) {
		u8_t len = strlen(m_at_list[i].string_upper);

		if ((strncmp(cmd, m_at_list[i].string_upper, len) == 0) ||
		    (strncmp(cmd, m_at_list[i].string_lower, len) == 0)) {
			return m_at_list[i].handler(param);
		}
	}

	return -ENOTSUP;
}

/**@brief API to initialize GPS AT commands handler
 */
int slm_at_gps_init(at_cmd_handler_t callback)
{
	if (callback == NULL) {
		LOG_ERR("No callback");
		return -EINVAL;
	}
	client.sock = INVALID_SOCKET;
	client.mask =  NRF_GNSS_NMEA_GSV_MASK |
		       NRF_GNSS_NMEA_GSA_MASK |
		       NRF_GNSS_NMEA_GLL_MASK |
		       NRF_GNSS_NMEA_GGA_MASK |
		       NRF_GNSS_NMEA_RMC_MASK;
	client.running = false;
	client.has_fix = false;
	client.callback = callback;
	gps_thread_id = NULL;

	return 0;
}
```

## src/slm_at_host.c
```c
/*
 * Copyright (c) 2019 Nordic Semiconductor ASA
 *
 * SPDX-License-Identifier: LicenseRef-BSD-5-Clause-Nordic
 */

#include <zephyr.h>
#include <stdio.h>
#include <ctype.h>
#include <logging/log.h>
#include <drivers/uart.h>
#include <string.h>
#include <init.h>
#include <at_cmd.h>
#include <at_notif.h>

LOG_MODULE_REGISTER(at_host, CONFIG_SLM_LOG_LEVEL);

#if defined(CONFIG_SLM_TCPIP_AT_MODE)
#include "slm_at_tcpip.h"
#endif

#if defined(CONFIG_SLM_GPS_AT_MODE)
#include "slm_at_gps.h"
#endif

#define SLM_UART_0_NAME      "UART_0"
#define SLM_UART_1_NAME      "UART_1"
#define SLM_UART_2_NAME      "UART_2"

#define OK_STR    "OK\r\n"
#define ERROR_STR "ERROR\r\n"

#define SLM_SYNC_STR "Ready\r\n"

#define AT_CMD_SLMVER	"AT#XSLMVER"
#define SLM_VERSION	"#XSLMVER: 1.1\r\n"
#define AT_CMD_SLEEP	"AT#XSLEEP"

#define AT_MAX_CMD_LEN		CONFIG_AT_CMD_RESPONSE_MAX_LEN

/** @brief Termination Modes. */
enum term_modes {
	MODE_NULL_TERM, /**< Null Termination */
	MODE_CR,        /**< CR Termination */
	MODE_LF,        /**< LF Termination */
	MODE_CR_LF,     /**< CR+LF Termination */
	MODE_COUNT      /* Counter of term_modes */
};


/** @brief UARTs. */
enum select_uart {
	UART_0,
	UART_1,
	UART_2
};

static enum term_modes term_mode;
static struct device *uart_dev;
static u8_t at_buf[AT_MAX_CMD_LEN];
static size_t at_buf_len;
static struct k_work cmd_send_work;
static const char termination[3] = { '\0', '\r', '\n' };

/* global variable defined in different files */
extern struct at_param_list m_param_list;
extern void enter_sleep(u16_t mode);

/* forward declaration */
void slm_at_host_uninit(void);

static inline void write_uart_string(char *str, size_t len)
{
	LOG_HEXDUMP_DBG(str, len, "TX");

	for (size_t i = 0; i < len; i++) {
		uart_poll_out(uart_dev, str[i]);
	}
}

static void response_handler(void *context, char *response)
{
	int len = strlen(response) + 1;

	ARG_UNUSED(context);

	/* Forward the data over UART */
	if (len > 1) {
		write_uart_string(response, len);
	}
}

static int handle_at_sleep(const char *at_cmd)
{
	int ret = -EINVAL;
	enum at_cmd_type type;
	u16_t shutdown_mode;

	ret = at_parser_params_from_str(at_cmd, NULL, &m_param_list);
	if (ret < 0) {
		LOG_ERR("Failed to parse AT command %d", ret);
		return -EINVAL;
	}

	type = at_parser_cmd_type_get(at_cmd);
	if (type == AT_CMD_TYPE_SET_COMMAND) {
		if (at_params_valid_count_get(&m_param_list) < 2) {
			LOG_ERR("AT parameter error");
			return -EINVAL;
		}
		ret = at_params_short_get(&m_param_list, 1, &shutdown_mode);
		if (ret < 0) {
			LOG_ERR("AT parameter error");
			return -EINVAL;
		}
		switch (shutdown_mode) {
		case SHUTDOWN_APP_MODEM:
		case SHUTDOWN_APP_ONLY:
			slm_at_host_uninit();
			/* fall over */
		case SHUTDOWN_MODEM_ONLY:
			enter_sleep(shutdown_mode);
			return 0;
		default:
			LOG_ERR("AT parameter error");
			return -EINVAL;
		}
	}

	return ret;
}

static void cmd_send(struct k_work *work)
{
	size_t chars;
	char str[15];
	static char buf[AT_MAX_CMD_LEN];
	enum at_cmd_state state;
	int err;
	size_t size_cmd = sizeof(AT_CMD_SLMVER) - 1;

	ARG_UNUSED(work);

	/* Make sure the string is 0-terminated */
	at_buf[MIN(at_buf_len, AT_MAX_CMD_LEN - 1)] = 0;

	LOG_HEXDUMP_DBG(at_buf, at_buf_len, "RX");

	if (slm_at_cmd_cmp(at_buf, AT_CMD_SLMVER, size_cmd)) {
		write_uart_string(SLM_VERSION, sizeof(SLM_VERSION));
		write_uart_string(OK_STR, sizeof(OK_STR));
		goto done;
	}

	size_cmd = sizeof(AT_CMD_SLEEP) - 1;
	if (slm_at_cmd_cmp(at_buf, AT_CMD_SLEEP, size_cmd)) {
		err = handle_at_sleep(at_buf);
		if (err == 0) {
			write_uart_string(OK_STR, sizeof(OK_STR));
			goto done;
		} else {
			write_uart_string(ERROR_STR, sizeof(ERROR_STR));
			goto done;
		}
	}

#if defined(CONFIG_SLM_TCPIP_AT_MODE)
	err = slm_at_tcpip_parse(at_buf);
	if (err == 0) {
		write_uart_string(OK_STR, sizeof(OK_STR));
		goto done;
	} else if (err != -ENOTSUP) {
		write_uart_string(ERROR_STR, sizeof(ERROR_STR));
		goto done;
	}
#endif /** CONFIG_SLM_TCPIP_AT_MODE */

#if defined(CONFIG_SLM_GPS_AT_MODE)
	err = slm_at_gps_parse(at_buf);
	if (err == 0) {
		write_uart_string(OK_STR, sizeof(OK_STR));
		goto done;
	} else if (err != -ENOTSUP) {
		write_uart_string(ERROR_STR, sizeof(ERROR_STR));
		goto done;
	}
#endif /** CONFIG_SLM_GPS_AT_MODE */

	err = at_cmd_write(at_buf, buf, AT_MAX_CMD_LEN, &state);
	if (err < 0) {
		LOG_ERR("Could not send AT command to modem: %d", err);
		state = AT_CMD_ERROR;
	}

	switch (state) {
	case AT_CMD_OK:
		write_uart_string(buf, strlen(buf));
		write_uart_string(OK_STR, sizeof(OK_STR));
		break;
	case AT_CMD_ERROR:
		write_uart_string(ERROR_STR, sizeof(ERROR_STR));
		break;
	case AT_CMD_ERROR_CMS:
		chars = sprintf(str, "+CMS: %d\r\n", err);
		write_uart_string(str, ++chars);
		break;
	case AT_CMD_ERROR_CME:
		chars = sprintf(str, "+CME: %d\r\n", err);
		write_uart_string(str, ++chars);
		break;
	default:
		break;
	}

done:
	uart_irq_rx_enable(uart_dev);
}

static void uart_rx_handler(u8_t character)
{
	static bool inside_quotes;
	static size_t cmd_len;
	size_t pos;

	cmd_len += 1;
	pos = cmd_len - 1;

	/* Handle special characters. */
	switch (character) {
	case 0x08: /* Backspace. */
		/* Fall through. */
	case 0x7F: /* DEL character */
		pos = pos ? pos - 1 : 0;
		at_buf[pos] = 0;
		cmd_len = cmd_len <= 1 ? 0 : cmd_len - 2;
		break;
	case '"':
		inside_quotes = !inside_quotes;
		 /* Fall through. */
	default:
		/* Detect AT command buffer overflow or zero length */
		if (cmd_len > AT_MAX_CMD_LEN) {
			LOG_ERR("Buffer overflow, dropping '%c'\n", character);
			cmd_len = AT_MAX_CMD_LEN;
			return;
		} else if (cmd_len < 1) {
			LOG_ERR("Invalid AT command length: %d", cmd_len);
			cmd_len = 0;
			return;
		}

		at_buf[pos] = character;
		break;
	}

	if (inside_quotes) {
		return;
	}

	/* Check if the character marks line termination. */
	switch (term_mode) {
	case MODE_NULL_TERM:
		/* Fall through. */
	case MODE_CR:
		if (character == termination[term_mode]) {
			goto send;
		}
		break;
	case MODE_LF:
		if ((at_buf[pos - 1]) &&
			character == termination[term_mode]) {
			goto send;
		}
		break;
	case MODE_CR_LF:
		if ((at_buf[pos - 1] == '\r') && (character == '\n')) {
			goto send;
		}
		break;
	default:
		LOG_ERR("Invalid termination mode: %d", term_mode);
		break;
	}

	return;
send:
	uart_irq_rx_disable(uart_dev);
	k_work_submit(&cmd_send_work);
	at_buf_len = cmd_len;
	cmd_len = 0;
}

static void isr(struct device *dev)
{
	u8_t character;

	uart_irq_update(dev);

	if (!uart_irq_rx_ready(dev)) {
		return;
	}

	while (uart_fifo_read(dev, &character, 1)) {
		uart_rx_handler(character);
	}
}

static int at_uart_init(char *uart_dev_name)
{
	int err;
	u8_t dummy;

	uart_dev = device_get_binding(uart_dev_name);
	if (uart_dev == NULL) {
		LOG_ERR("Cannot bind %s\n", uart_dev_name);
		return -EINVAL;
	}
	/* Wait for the UART line to become valid */
	do {
		err = uart_err_check(uart_dev);
		if (err) {
			LOG_ERR("UART check failed: %d. "
				"Dropping buffer and retrying.", err);

			while (uart_fifo_read(uart_dev, &dummy, 1)) {
				/* Do nothing with the data */
			}
			k_sleep(10);
		}
	} while (err);

	uart_irq_callback_set(uart_dev, isr);
	return err;
}

static void slm_at_callback(char *str)
{
	write_uart_string(str, strlen(str));
}

int slm_at_host_init(void)
{
	char *uart_dev_name;
	int err;
	enum select_uart uart_id = CONFIG_SLM_CONNECT_UART;
	enum term_modes mode = CONFIG_SLM_AT_HOST_TERMINATION;

	/* Choosing the termination mode */
	if (mode < MODE_COUNT) {
		term_mode = mode;
	} else {
		return -EINVAL;
	}

	/* Choose which UART to use */
	switch (uart_id) {
	case UART_0:
		uart_dev_name = SLM_UART_0_NAME;
		break;
	case UART_1:
		uart_dev_name = SLM_UART_1_NAME;
		break;
	case UART_2:
		uart_dev_name = SLM_UART_2_NAME;
		break;
	default:
		LOG_ERR("Unknown UART instance %d", uart_id);
		return -EINVAL;
	}

	err = at_notif_register_handler(NULL, response_handler);
	if (err != 0) {
		LOG_ERR("Can't register handler err=%d", err);
		return err;
	}

	/* Initialize the UART module */
	err = at_uart_init(uart_dev_name);
	if (err) {
		LOG_ERR("UART can not be initialized: %d", err);
		return -EFAULT;
	}

	k_work_init(&cmd_send_work, cmd_send);
	uart_irq_rx_enable(uart_dev);

	write_uart_string(SLM_SYNC_STR, sizeof(SLM_SYNC_STR)-1);

#if defined(CONFIG_SLM_TCPIP_AT_MODE)
	/* Initialize the TCPIP module */
	err = slm_at_tcpip_init(slm_at_callback);
	if (err) {
		LOG_ERR("TCPIP could not be initialized: %d", err);
		return -EFAULT;
	}
#endif
#if defined(CONFIG_SLM_GPS_AT_MODE)
	/* Initialize the GPS module */
	err = slm_at_gps_init(slm_at_callback);
	if (err) {
		LOG_ERR("GPS could not be initialized: %d", err);
		return -EFAULT;
	}
#endif
	LOG_DBG("at_host init done");
	return err;
}

void slm_at_host_uninit(void)
{
	int err;

#if defined(CONFIG_SLM_TCPIP_AT_MODE)
	/* Uninitialize the TCPIP module */
	err = slm_at_tcpip_uninit();
	if (err) {
		LOG_WRN("TCPIP could not be uninitialized: %d", err);
	}
#endif
#if defined(CONFIG_SLM_GPS_AT_MODE)
	/* Uninitialize the GPS module */
	err = slm_at_gps_uninit();
	if (err) {
		LOG_WRN("GPS could not be uninitialized: %d", err);
	}
#endif
	err = at_notif_deregister_handler(NULL, response_handler);
	if (err != 0) {
		LOG_WRN("Can't deregister handler err=%d", err);
	}
#if defined(CONFIG_DEVICE_POWER_MANAGEMENT)
	err = device_set_power_state(uart_dev, DEVICE_PM_OFF_STATE,
				NULL, NULL);
	if (err != 0) {
		LOG_WRN("Can't power off uart err=%d", err);
	}
#endif
	LOG_DBG("at_host uninit done");
}
```

## src/slm_at_host.h
```c
/*
 * Copyright (c) 2019 Nordic Semiconductor ASA
 *
 * SPDX-License-Identifier: LicenseRef-BSD-5-Clause-Nordic
 */

#ifndef SLM_AT_HOST_
#define SLM_AT_HOST_

/**@file slm_at_host.h
 *
 * @brief AT host for serial LTE modem
 * @{
 */

#include <zephyr/types.h>
#include <at_cmd_parser/at_cmd_parser.h>
#include <at_cmd.h>

/**@brief AT command handler type. */
typedef int (*slm_at_handler_t)(const char *at_cmd);

typedef struct slm_at_cmd_list {
	u8_t type;
	char *string_upper;
	char *string_lower;
	slm_at_handler_t handler;
} slm_at_cmd_list_t;

/**
 * @brief Initialize AT host for serial LTE modem
 *
 * @retval 0 If the operation was successful.
 *           Otherwise, a (negative) error code is returned.
 */
int slm_at_host_init(void);

/** @} */

#endif /* SLM_AT_HOST_ */
```

## src/slm_at_tcpip.c
```c
/*
 * Copyright (c) 2019 Nordic Semiconductor ASA
 *
 * SPDX-License-Identifier: LicenseRef-BSD-5-Clause-Nordic
 */
#include <logging/log.h>
#include <zephyr.h>
#include <stdio.h>
#include <string.h>
#include <net/socket.h>
#include "slm_at_tcpip.h"

LOG_MODULE_REGISTER(tcpip, CONFIG_SLM_LOG_LEVEL);

#define INVALID_SOCKET	-1
#define TCPIP_MAX_URL	128

/*
 * Known limitation in this version
 * - Multiple concurrent sockets
 * - Socket type other than SOCK_STREAM(1) and SOCK_DGRAM(2)
 * - IP Protocol other than TCP(6) and UDP(17)
 * - TCP/UDP server mode
 * - Receive more than IPv4 MTU one-time
 * - IPv6 support
 */

/**@brief Socket operations. */
enum slm_socket_operation {
	AT_SOCKET_CLOSE,
	AT_SOCKET_OPEN
};

/**@brief List of supported AT commands. */
enum slm_tcpip_at_cmd_type {
	AT_SOCKET,
	AT_BIND,
	AT_TCP_CONNECT,
	AT_TCP_SEND,
	AT_TCP_RECV,
	AT_UDP_SENDTO,
	AT_UDP_RECVFROM,
	AT_TCPIP_MAX
};

/** forward declaration of cmd handlers **/
static int handle_at_socket(const char *at_cmd);
static int handle_at_bind(const char *at_cmd);
static int handle_at_tcp_conn(const char *at_cmd);
static int handle_at_tcp_send(const char *at_cmd);
static int handle_at_tcp_recv(const char *at_cmd);
static int handle_at_udp_sendto(const char *at_cmd);
static int handle_at_udp_recvfrom(const char *at_cmd);

#define MAX_TCP_CMD_LEN 32

/**@brief SLM AT Command list type. */
static slm_at_cmd_list_t m_at_list[AT_TCPIP_MAX] = {
	{AT_SOCKET, "AT#XSOCKET", "at#xsocket",
		handle_at_socket},
	{AT_BIND, "AT#XBIND", "at#xbind",
		handle_at_bind},
	{AT_TCP_CONNECT, "AT#XTCPCONN", "at#xtcpconn",
		handle_at_tcp_conn},
	{AT_TCP_SEND, "AT#XTCPSEND", "at#xtcpsend",
		handle_at_tcp_send},
	{AT_TCP_RECV, "AT#XTCPRECV", "at#xtcprecv",
		handle_at_tcp_recv},
	{AT_UDP_SENDTO, "AT#XUDPSENDTO", "at#xudpsendto",
		handle_at_udp_sendto},
	{AT_UDP_RECVFROM, "AT#XUDPRECVFROM", "at#xudprecvfrom",
		handle_at_udp_recvfrom},
};

static struct sockaddr_storage remote;

static struct tcpip_client {
	int sock; /* Socket descriptor. */
	enum net_ip_protocol ip_proto; /* IP protocol */
	bool connected; /* TCP connected flag */
	at_cmd_handler_t callback;
} client;

static char buf[64];

/* global variable defined in different files */
extern struct at_param_list m_param_list;

/**@brief Check whether a string has valid IPv4 address or not
 */
static bool check_for_ipv4(const char *address, u8_t length)
{
	int index;

	for (index = 0; index < length; index++) {
		char ch = *(address + index);

		if ((ch == '.') || (ch >= '0' && ch <= '9')) {
			continue;
		} else {
			return false;
		}
	}

	return true;
}

/**@brief Resolves host IPv4 address and port
 */
static int parse_host_by_ipv4(const char *ip, u16_t port)
{
	struct sockaddr_in *address4 = ((struct sockaddr_in *)&remote);

	address4->sin_family = AF_INET;
	address4->sin_port = htons(port);
	LOG_DBG("IPv4 Address %s", log_strdup(ip));
	/* NOTE inet_pton() returns 1 as success */
	if (inet_pton(AF_INET, ip, &address4->sin_addr) == 1) {
		return 0;
	} else {
		return -EINVAL;
	}
}


static int parse_host_by_name(const char *name, u16_t port, int socktype)
{
	int err;
	struct addrinfo *result;
	struct addrinfo hints = {
		.ai_family = AF_INET,
		.ai_socktype = socktype
	};
	char ipv4_addr[NET_IPV4_ADDR_LEN];

	err = getaddrinfo(name, NULL, &hints, &result);
	if (err) {
		LOG_ERR("ERROR: getaddrinfo failed %d", err);
		return err;
	}

	if (result == NULL) {
		LOG_ERR("ERROR: Address not found\n");
		return -ENOENT;
	}

	/* IPv4 Address. */
	struct sockaddr_in *server4 = ((struct sockaddr_in *)&remote);

	server4->sin_addr.s_addr =
		((struct sockaddr_in *)result->ai_addr)->sin_addr.s_addr;
	server4->sin_family = AF_INET;
	server4->sin_port = htons(port);

	inet_ntop(AF_INET, &server4->sin_addr.s_addr, ipv4_addr,
		  sizeof(ipv4_addr));
	LOG_DBG("IPv4 Address found %s\n", ipv4_addr);

	/* Free the address. */
	freeaddrinfo(result);

	return 0;
}

static int do_socket_open(u8_t type)
{
	int ret = 0;

	if (type == SOCK_STREAM) {
		client.sock = socket(AF_INET, SOCK_STREAM,
				IPPROTO_TCP);
		client.ip_proto = IPPROTO_TCP;
	} else if (type == SOCK_DGRAM) {
		client.sock = socket(AF_INET, SOCK_DGRAM,
				IPPROTO_UDP);
		client.ip_proto = IPPROTO_UDP;
	}
	if (client.sock < 0) {
		LOG_ERR("socket() failed: %d", -errno);
		sprintf(buf, "#XSOCKET: %d\r\n", -errno);
		client.callback(buf);
		client.ip_proto = IPPROTO_IP;
		ret = -errno;
	} else {
		sprintf(buf, "#XSOCKET: %d, %d\r\n", client.sock,
			client.ip_proto);
		client.callback(buf);
	}

	LOG_DBG("Socket opened");
	return ret;
}

static int do_socket_close(int error)
{
	int ret = 0;

	if (client.sock > 0) {
		ret = close(client.sock);
		if (ret < 0) {
			LOG_WRN("close() failed: %d", -errno);
			ret = -errno;
		}
		client.sock = INVALID_SOCKET;
		client.ip_proto = IPPROTO_IP;
		client.connected = false;

		sprintf(buf, "#XSOCKET: %d\r\n", error);
		client.callback(buf);
		LOG_DBG("Socket closed");
	}

	return ret;
}

static int do_bind(const char *ip, u16_t port)
{
	int ret;
	struct sockaddr_in local;

	LOG_DBG("%s:%d", log_strdup(ip), port);

	if (!check_for_ipv4(ip, strlen(ip))) {
		LOG_ERR("Not IPv4 address");
		return -EINVAL;
	}

	local.sin_family = AF_INET;
	local.sin_port = htons(port);
	/* NOTE inet_pton() returns 1 as success */
	if (inet_pton(AF_INET, ip, &local.sin_addr) != 1) {
		LOG_ERR("Parse failed: %d", -errno);
		return -EINVAL;
	}

	ret = bind(client.sock, (struct sockaddr *)&local,
		 sizeof(struct sockaddr_in));
	if (ret < 0) {
		LOG_ERR("bind() failed: %d", -errno);
		do_socket_close(-errno);
		return -errno;
	}

	return 0;
}

static int do_tcp_connect(const char *url, u16_t port)
{
	int ret;

	LOG_DBG("%s:%d", log_strdup(url), port);

	if (check_for_ipv4(url, strlen(url))) {
		ret = parse_host_by_ipv4(url, port);
	} else {
		ret = parse_host_by_name(url, port, SOCK_STREAM);
	}
	if (ret) {
		LOG_ERR("Parse failed: %d", ret);
		return ret;
	}

	ret = connect(client.sock, (struct sockaddr *)&remote,
		 sizeof(struct sockaddr_in));
	if (ret < 0) {
		LOG_ERR("connect() failed: %d", -errno);
		do_socket_close(-errno);
		return -errno;
	}

	client.connected = true;
	client.callback("#XTCPCONN: 1\r\n");
	return 0;
}

static int do_tcp_send(const char *data)
{
	u32_t offset = 0;
	u32_t datalen = strlen(data);
	int ret;

	while (offset < datalen) {
		ret = send(client.sock, data + offset,
			   datalen - offset, 0);
		if (ret < 0) {
			do_socket_close(-errno);
			LOG_WRN("send() failed: %d", -errno);
			break;
		}

		offset += ret;
	}

	sprintf(buf, "#XTCPSEND: %d\r\n", offset);
	client.callback(buf);
	LOG_DBG("TCP sent");
	return 0;
}

static int do_tcp_receive(u16_t length, u16_t time)
{
	int ret;
	char data[NET_IPV4_MTU];
	struct timeval tmo = {
		.tv_sec = time
	};

	ret = setsockopt(client.sock, SOL_SOCKET, SO_RCVTIMEO,
			&tmo, sizeof(struct timeval));
	if (ret < 0) {
		do_socket_close(-errno);
		LOG_ERR("setsockopt() error: %d", -errno);
		return ret;
	}

	if (length > NET_IPV4_MTU) {
		ret = recv(client.sock, data, NET_IPV4_MTU, 0);
	} else {
		ret = recv(client.sock, data, length, 0);
	}
	if (ret < 0) {
		LOG_WRN("recv() error: %d", -errno);
		do_socket_close(-errno);
		ret = -errno;
	} else if (ret == 0) {
		/**
		 * When a stream socket peer has performed an orderly shutdown,
		 * the return value will be 0 (the traditional "end-of-file")
		 * The value 0 may also be returned if the requested number of
		 * bytes to receive from a stream socket was 0
		 * In both cases, treat as normal shutdown by remote
		 */
		LOG_WRN("recv() return 0");
		do_socket_close(0);
	} else {
		data[ret] = '\0';
		client.callback("#XTCPRECV: ");
		client.callback(data);
		client.callback("\r\n");
		sprintf(buf, "#XTCPRECV: %d\r\n", ret);
		client.callback(buf);
		ret = 0;
	}

	LOG_DBG("TCP received");
	return ret;
}

static int do_udp_init(const char *url, u16_t port)
{
	int ret;

	if (check_for_ipv4(url, strlen(url))) {
		ret = parse_host_by_ipv4(url, port);
	} else {
		ret = parse_host_by_name(url, port, SOCK_DGRAM);
	}
	if (ret) {
		LOG_ERR("Parse failed: %d", ret);
		return ret;
	}

	LOG_DBG("UDP initialized");
	return 0;
}

static int do_udp_sendto(const char *url, u16_t port, const char *data)
{
	u32_t offset = 0;
	u32_t datalen = strlen(data);
	int ret;

	ret = do_udp_init(url, port);
	if (ret < 0) {
		return ret;
	};

	while (offset < datalen) {
		ret = sendto(client.sock, data + offset,
			   datalen - offset, 0,
			   (struct sockaddr *)&remote,
			   sizeof(struct sockaddr_in));
		if (ret <= 0) {
			LOG_ERR("sendto() failed: %d", -errno);
			do_socket_close(-errno);
			return -errno;
		}

		offset += ret;
	}

	sprintf(buf, "#XUDPSENDTO: %d\r\n", offset);
	client.callback(buf);
	LOG_DBG("UDP sent");
	return 0;
}

static int do_udp_recvfrom(const char *url, u16_t port, u16_t length,
			u16_t time)
{
	int ret;
	char data[NET_IPV4_MTU];
	int sockaddr_len = sizeof(struct sockaddr);
	struct timeval tmo = {
		.tv_sec = time
	};

	ret = do_udp_init(url, port);
	if (ret < 0) {
		return ret;
	};

	ret = setsockopt(client.sock, SOL_SOCKET, SO_RCVTIMEO,
			&tmo, sizeof(struct timeval));
	if (ret < 0) {
		LOG_ERR("setsockopt() error: %d", -errno);
		do_socket_close(-errno);
		return ret;
	}

	if (length > NET_IPV4_MTU) {
		ret = recvfrom(client.sock, data, NET_IPV4_MTU, 0,
			(struct sockaddr *)&remote, &sockaddr_len);
	} else {
		ret = recvfrom(client.sock, data, length, 0,
			(struct sockaddr *)&remote, &sockaddr_len);
	}
	if (ret < 0) {
		LOG_WRN("recvfrom() error: %d", -errno);
		do_socket_close(-errno);
		ret = -errno;
	} else {
		/**
		 * Datagram sockets in various domains permit zero-length
		 * datagrams. When such a datagram is received, the return
		 * value is 0. Treat as normal case
		 */
		data[ret] = '\0';
		client.callback("#XUDPRECV: ");
		client.callback(data);
		client.callback("\r\n");
		sprintf(buf, "#XUDPRECV: %d\r\n", ret);
		client.callback(buf);
		ret = 0;
	}

	LOG_DBG("UDP received");
	return ret;
}

/**@brief handle AT#XSOCKET commands
 *  AT#XSOCKET=<op>[,<type>]
 *  AT#XSOCKET?
 *  AT#XSOCKET=? TEST command not supported
 */
static int handle_at_socket(const char *at_cmd)
{
	int err = -EINVAL;
	u16_t op;

	switch (at_parser_cmd_type_get(at_cmd)) {
	case AT_CMD_TYPE_SET_COMMAND:
		if (at_params_valid_count_get(&m_param_list) < 2) {
			return -EINVAL;
		}

		err = at_params_short_get(&m_param_list, 1, &op);
		if (err < 0) {
			return err;
		};

		if (op == 1) {
			u16_t type;

			if (at_params_valid_count_get(&m_param_list) < 3) {
				return -EINVAL;
			}

			err = at_params_short_get(&m_param_list, 2, &type);
			if (err < 0) {
				return err;
			};

			if (client.sock > 0) {
				LOG_WRN("Socket is already opened");
			} else {
				err = do_socket_open(type);
			}
		} else if (op == 0) {
			if (client.sock < 0) {
				LOG_WRN("Socket is not opened yet");
			} else {
				err = do_socket_close(0);
			}
		}

		break;

	case AT_CMD_TYPE_READ_COMMAND:
		if (client.sock != INVALID_SOCKET) {
			sprintf(buf, "#XSOCKET: %d, %d\r\n", client.sock,
				client.ip_proto);
		} else {
			sprintf(buf, "#XSOCKET: 0\r\n");
		}

		client.callback(buf);

		err = 0;
		break;

	case AT_CMD_TYPE_TEST_COMMAND:
	default:
		err = -EINVAL;
		break;
	}

	return err;
}

/**@brief handle AT#XBIND commands
 *  AT#XBIND=<local_ip>,<port>
 *  AT#XBIND?
 *  AT#XBIND=? TEST command not supported
 */
static int handle_at_bind(const char *at_cmd)
{
	int err = -EINVAL;
	char ip[TCPIP_MAX_URL];
	int size = TCPIP_MAX_URL;
	u16_t port;

	switch (at_parser_cmd_type_get(at_cmd)) {
	case AT_CMD_TYPE_SET_COMMAND:
		if (at_params_valid_count_get(&m_param_list) < 3) {
			return -EINVAL;
		}

		err = at_params_string_get(&m_param_list, 1, ip, &size);
		if (err < 0) {
			return err;
		};

		ip[size] = '\0';
		err = at_params_short_get(&m_param_list, 2, &port);
		if (err < 0) {
			return err;
		};

		err = do_bind(ip, port);
		break;

	case AT_CMD_TYPE_READ_COMMAND:
	case AT_CMD_TYPE_TEST_COMMAND:
	default:
		err = -EINVAL;
		break;
	}

	return err;
}

/**@brief handle AT#XTCPCONN commands
 *  AT#XTCPCONN=<url>,<port>
 *  AT#XTCPCONN?
 *  AT#XTCPCONN=? TEST command not supported
 */
static int handle_at_tcp_conn(const char *at_cmd)
{
	int err = -EINVAL;
	char url[TCPIP_MAX_URL];
	int size = TCPIP_MAX_URL;
	u16_t port;

	if (client.sock < 0) {
		LOG_ERR("Socket not opened yet");
		return err;
	}

	switch (at_parser_cmd_type_get(at_cmd)) {
	case AT_CMD_TYPE_SET_COMMAND:
		if (at_params_valid_count_get(&m_param_list) < 3) {
			return -EINVAL;
		}

		err = at_params_string_get(&m_param_list, 1, url, &size);
		if (err < 0) {
			return err;
		};

		url[size] = '\0';
		err = at_params_short_get(&m_param_list, 2, &port);
		if (err < 0) {
			return err;
		};

		err = do_tcp_connect(url, port);
		break;

	case AT_CMD_TYPE_READ_COMMAND:
		if (client.connected) {
			client.callback("+XTCPCONN: 1\r\n");
		} else {
			client.callback("+XTCPCONN: 0\r\n");
		}

		err = 0;
		break;

	case AT_CMD_TYPE_TEST_COMMAND:
	default:
		err = -EINVAL;
		break;
	}

	return err;
}

/**@brief handle AT#XTCPSEND commands
 *  AT#XTCPSEND=<data>
 *  AT#XTCPSEND? READ command not supported
 *  AT#XTCPSEND=? TEST command not supported
 */
static int handle_at_tcp_send(const char *at_cmd)
{
	int err = -EINVAL;
	char data[NET_IPV4_MTU];
	int size = NET_IPV4_MTU;

	if (!client.connected) {
		LOG_ERR("TCP not connected yet");
		return err;
	}

	switch (at_parser_cmd_type_get(at_cmd)) {
	case AT_CMD_TYPE_SET_COMMAND:
		if (at_params_valid_count_get(&m_param_list) < 2) {
			return -EINVAL;
		}

		err = at_params_string_get(&m_param_list, 1, data, &size);
		if (err < 0) {
			return err;
		};

		data[size] = '\0';
		err = do_tcp_send(data);
		break;

	case AT_CMD_TYPE_READ_COMMAND:
	case AT_CMD_TYPE_TEST_COMMAND:
	default:
		err = -EINVAL;
		break;
	}

	return err;
}

/**@brief handle AT#XTCPRECV commands
 *  AT#XTCPRECV=<length>
 *  AT#XTCPRECV? READ command not supported
 *  AT#XTCPRECV=? TEST command not supported
 */
static int handle_at_tcp_recv(const char *at_cmd)
{
	int err = -EINVAL;
	u16_t length, time;

	if (!client.connected) {
		LOG_ERR("TCP not connected yet");
		return err;
	}

	switch (at_parser_cmd_type_get(at_cmd)) {
	case AT_CMD_TYPE_SET_COMMAND:
		if (at_params_valid_count_get(&m_param_list) < 3) {
			return -EINVAL;
		}

		err = at_params_short_get(&m_param_list, 1, &length);
		if (err < 0) {
			return err;
		};

		err = at_params_short_get(&m_param_list, 2, &time);
		if (err < 0) {
			return err;
		};

		err = do_tcp_receive(length, time);
		break;

	case AT_CMD_TYPE_READ_COMMAND:
	case AT_CMD_TYPE_TEST_COMMAND:
	default:
		err = -EINVAL;
		break;
	}

	return err;
}

/**@brief handle AT#XUDPSENDTO commands
 *  AT#XUDPSENDTO=<url>,<port>,<data>
 *  AT#XUDPSENDTO? READ command not supported
 *  AT#XUDPSENDTO=? TEST command not supported
 */
static int handle_at_udp_sendto(const char *at_cmd)
{
	int err = -EINVAL;
	char url[TCPIP_MAX_URL];
	u16_t port;
	char data[NET_IPV4_MTU];
	int size;

	if (client.sock < 0) {
		LOG_ERR("Socket not opened yet");
		return err;
	} else if (client.ip_proto != IPPROTO_UDP) {
		LOG_ERR("Invalid socket");
		return err;
	}

	switch (at_parser_cmd_type_get(at_cmd)) {
	case AT_CMD_TYPE_SET_COMMAND:
		if (at_params_valid_count_get(&m_param_list) < 4) {
			return -EINVAL;
		}

		size = TCPIP_MAX_URL;
		err = at_params_string_get(&m_param_list, 1, url, &size);
		if (err < 0) {
			return err;
		};

		url[size] = '\0';
		err = at_params_short_get(&m_param_list, 2, &port);
		if (err < 0) {
			return err;
		};

		size = NET_IPV4_MTU;
		err = at_params_string_get(&m_param_list, 3, data, &size);
		if (err < 0) {
			return err;
		};

		data[size] = '\0';
		err = do_udp_sendto(url, port, data);
		break;

	case AT_CMD_TYPE_READ_COMMAND:
	case AT_CMD_TYPE_TEST_COMMAND:
	default:
		err = -EINVAL;
		break;
	}

	return err;
}

/**@brief handle AT#XUDPRECVFROM commands
 *  AT#XUDPRECVFROM=<url>,<port>,<length>
 *  AT#XUDPRECVFROM? READ command not supported
 *  AT#XUDPRECVFROM=? TEST command not supported
 */
static int handle_at_udp_recvfrom(const char *at_cmd)
{
	int err = -EINVAL;
	char url[TCPIP_MAX_URL];
	int size = TCPIP_MAX_URL;
	u16_t port, length, time;

	if (client.sock < 0) {
		LOG_ERR("Socket not opened yet");
		return err;
	} else if (client.ip_proto != IPPROTO_UDP) {
		LOG_ERR("Invalid socket");
		return err;
	}

	switch (at_parser_cmd_type_get(at_cmd)) {
	case AT_CMD_TYPE_SET_COMMAND:
		if (at_params_valid_count_get(&m_param_list) < 5) {
			return -EINVAL;
		}

		err = at_params_string_get(&m_param_list, 1, url, &size);
		if (err < 0) {
			return err;
		};

		url[size] = '\0';
		err = at_params_short_get(&m_param_list, 2, &port);
		if (err < 0) {
			return err;
		};

		err = at_params_short_get(&m_param_list, 3, &length);
		if (err < 0) {
			return err;
		};

		err = at_params_short_get(&m_param_list, 4, &time);
		if (err < 0) {
			return err;
		};

		err = do_udp_recvfrom(url, port, length, time);
		break;

	case AT_CMD_TYPE_READ_COMMAND:
	case AT_CMD_TYPE_TEST_COMMAND:
	default:
		err = -EINVAL;
		break;
	}

	return err;
}

/**@brief API to handle TCP/IP AT commands
 */
int slm_at_tcpip_parse(const u8_t *param, u8_t length)
{
	int ret;
	u8_t cmd[MAX_TCP_CMD_LEN];
	size_t cmd_len = sizeof(cmd);

	ARG_UNUSED(length);

	ret = at_parser_params_from_str(param, NULL, &m_param_list);
	if (ret < 0) {
		LOG_ERR("Failed to parse command");
		return ret;
	};

	ret = at_params_string_get(&m_param_list, 0, cmd, &cmd_len);
	if (ret < 0) {
		LOG_ERR("Failed to retrieve command");
		return ret;
	};

	if (cmd_len < 3) {
		return -ENOTSUP;
	}

	for (int i = 0; i < AT_TCPIP_MAX; i++) {
		u8_t len = strlen(m_at_list[i].string_upper);

		if ((strncmp(cmd, m_at_list[i].string_upper, len) == 0) ||
		    (strncmp(cmd, m_at_list[i].string_lower, len) == 0)) {
			return m_at_list[i].handler(param);
		}
	}

	return -ENOTSUP;
}

/**@brief API to initialize TCP/IP AT commands handler
 */
int slm_at_tcpip_init(at_cmd_handler_t callback)
{
	if (callback == NULL) {
		LOG_ERR("No callback");
		return -EINVAL;
	}
	client.sock = INVALID_SOCKET;
	client.connected = false;
	client.ip_proto = IPPROTO_IP;
	client.callback = callback;
	return 0;
}
```
